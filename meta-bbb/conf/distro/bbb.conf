## meta-bbb/conf/distro/bbb.conf
```bitbake
# conf/distro/bbb.conf
DISTRO         = "BeagleBone Blue"
DISTRO_NAME    = "Custom Distribution for the BeagleBone Blue"
DISTRO_VERSION = "1.0"

COMBINED_FEATURES = "alsa api-documentation bluetooth ipsec ipv6 opengl usbhost wifi"
```

## meta-bbb/conf/machine/beagleboneblue.conf
```bitbake
# conf/machine/beagleboneblue.conf

#@TYPE: Machine 
#@NAME: BeagleBone Blue Machine
#@DESCRIPTION: Machine Configuration File for the BeagleBone Blue

# SoC Specific Configuration
require conf/machine/include/ti-soc.inc

SOC_FAMILY:append = ":ti33x"

# Architecture Specific Configuration
DEFAULTTUNE = "armv7athf-neon"

require conf/machine/include/arm/armv7a/tune-cortexa8.inc

# Graphics Specific Configuration
require conf/machine/include/mesa-pvr.inc

# Default Provider Configuration

# Kernel Providers
PREFERRED_PROVIDER_virtual/kernel = "linux-ti-staging"

PREFERRED_PROVIDER_virtual/bootloader = "u-boot-ti-staging"

# Graphics Providers
PREFERRED_PROVIDER_virtual/gpudriver = "ti-sgx-ddk-km"

PVR_DISPLAY_CONTROLLER_ALIAS = "tilcdc"

# Kernel Device Tree Configuration
KERNEL_IMAGETYPE  = "zImage"

KERNEL_DEVICETREE_PREFIX = " \
    am335x \
    ti/omap/am335x \
"

KERNEL_DEVICETREE = " \
    am335x-evm.dtb \
    am335x-evmsk.dtb \
    am335x-icev2.dtb \
    am335x-boneblue.dtb \
"

# Bootloader Configuration
UBOOT_ARCH    = "arm"
UBOOT_MACHINE = "am335x_evm_config"
UBOOT_BINARY  = "u-boot.img"

UBOOT_ENTRYPOINT  = "0x80008000"
UBOOT_LOADADDRESS = "0x80008000"

# Generate extlinux.conf
UBOOT_EXTLINUX = "1"
UBOOT_EXTLINUX_ROOT = "root=PARTUUID=${uuid}"
UBOOT_EXTLINUX_KERNEL_ARGS = "rootwait rw earlycon"
UBOOT_EXTLINUX_BOOT_FILES = " \
    extlinux.conf;extlinux/extlinux.conf \
    ${KERNEL_IMAGETYPE} \
    ${KERNEL_DEVICETREE} \
"

SPL_BINARY = "MLO"
UBOOT_SUFFIX = "img"

# Use the expected value of the ubifs filesystem's volume name in the kernel and u-boot
UBI_VOLNAME = "rootfs"

EXTRA_IMAGEDEPENDS += "virtual/bootloader"

MACHINE_ESSENTIAL_EXTRA_RDEPENDS += "kernel-image-zimage"

MACHINE_ESSENTIAL_EXTRA_RRECOMMENDS += "amx3-cm3 prueth-fw pruhsr-fw pruprp-fw"

IMAGE_FSTYPES += "tar.xz wic.xz wic.bmap ext4"

WKS_FILE ?= "sdimage-2part.wks"

IMAGE_BOOT_FILES ?= "${SPL_BINARY} u-boot.${UBOOT_SUFFIX} ${UBOOT_EXTLINUX_BOOT_FILES}"

do_image_wic[depends] += "virtual/bootloader:do_deploy"

# Miscalleneous Configuration
MACHINE_FEATURES  = "alsa bluetooth qemu-usermode screen usbhost vfat wifi"

MACHINE_GUI_CLASS = "bigscreen"

SERIAL_CONSOLES   = "115200;ttyS0"
```
